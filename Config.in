## Config.in
```kconfig
source "$BR2_EXTERNAL_KNIXX_BUILDROOT_PATH/package/rpi3-wifi-firmware/Config.in"
source "$BR2_EXTERNAL_KNIXX_BUILDROOT_PATH/package/knxd/Config.in"
source "$BR2_EXTERNAL_KNIXX_BUILDROOT_PATH/package/mqtt-knx/Config.in"
source "$BR2_EXTERNAL_KNIXX_BUILDROOT_PATH/package/knxmqtt/Config.in"
```

## configs/fez_defconfig
```kconfig
BR2_arm=y
BR2_cortex_a53=y
BR2_ARM_FPU_NEON_VFPV4=y

BR2_TOOLCHAIN_BUILDROOT_CXX=y

BR2_SYSTEM_DHCP="eth0"

# Linux headers same as kernel, a 4.9 series
BR2_PACKAGE_HOST_LINUX_HEADERS_CUSTOM_4_9=y

BR2_LINUX_KERNEL=y
BR2_LINUX_KERNEL_CUSTOM_GIT=y
BR2_LINUX_KERNEL_CUSTOM_REPO_URL="https://github.com/raspberrypi/linux.git"
BR2_LINUX_KERNEL_CUSTOM_REPO_VERSION="5e4ee836560d4c0371e109bf469e1ad808ae7a44"
BR2_LINUX_KERNEL_DEFCONFIG="bcm2709"

# Build the DTB from the kernel sources
BR2_LINUX_KERNEL_DTS_SUPPORT=y
BR2_LINUX_KERNEL_INTREE_DTS_NAME="bcm2710-rpi-3-b bcm2710-rpi-cm3"

BR2_PACKAGE_LINUX_FIRMWARE_BRCM_BCM43XX=y
BR2_PACKAGE_LINUX_FIRMWARE_BRCM_BCM43XXX=y
BR2_PACKAGE_LINUX_FIRMWARE_RALINK_RT61=y
BR2_PACKAGE_LINUX_FIRMWARE_RALINK_RT73=y
BR2_PACKAGE_LINUX_FIRMWARE_RALINK_RT2XX=y
BR2_PACKAGE_LINUX_FIRMWARE_RTL_81XX=y
BR2_PACKAGE_LINUX_FIRMWARE_RTL_87XX=y
BR2_PACKAGE_LINUX_FIRMWARE_RTL_88XX=y

BR2_PACKAGE_RPI_FIRMWARE=y

BR2_PACKAGE_LIBEV=y
BR2_PACKAGE_LIBUSB=y

BR2_PACKAGE_DROPBEAR=y
BR2_PACKAGE_DROPBEAR_DISABLE_REVERSEDNS=y
BR2_PACKAGE_DROPBEAR_WTMP=y
BR2_PACKAGE_NTP=y
BR2_PACKAGE_RSYNC=y
BR2_PACKAGE_WIRELESS_TOOLS=y
BR2_PACKAGE_WPA_SUPPLICANT=y
BR2_PACKAGE_WPA_SUPPLICANT_AP_SUPPORT=y
BR2_PACKAGE_WPA_SUPPLICANT_HOTSPOT=y
BR2_PACKAGE_WPA_SUPPLICANT_DEBUG_SYSLOG=y
BR2_PACKAGE_WPA_SUPPLICANT_CLI=y
BR2_PACKAGE_WPA_SUPPLICANT_PASSPHRASE=y

# Required tools to create the SD image
BR2_PACKAGE_HOST_DOSFSTOOLS=y
BR2_PACKAGE_HOST_GENIMAGE=y
BR2_PACKAGE_HOST_MTOOLS=y

# Filesystem / image
BR2_TARGET_ROOTFS_EXT2=y
BR2_TARGET_ROOTFS_EXT2_4=y
# BR2_TARGET_ROOTFS_TAR is not set
BR2_ROOTFS_POST_BUILD_SCRIPT="board/raspberrypi-fez/post-build.sh"
BR2_ROOTFS_POST_IMAGE_SCRIPT="board/raspberrypi-fez/post-image.sh"
BR2_ROOTFS_POST_SCRIPT_ARGS="--add-pi3-miniuart-bt-overlay"

BR2_PACKAGE_RPI3_WIFI_FIRMWARE=y
BR2_PACKAGE_KNXD=y
BR2_PACKAGE_KNXMQTT=y
```

## package/knxd/Config.in
```kconfig
config BR2_PACKAGE_KNXD
  bool "knxd"
  depends on BR2_PACKAGE_LIBEV
  depends on BR2_PACKAGE_LIBUSB
  select BR2_PACKAGE_ARGP_STANDALONE
  help
    KNXD daemon
```

## package/knxmqtt/Config.in
```kconfig
config BR2_PACKAGE_KNXMQTT
	bool "knxmqtt"
  depends on BR2_PACKAGE_KNXD
  select BR2_PACKAGE_MOSQUITTO
	help
	  mqttnxd is a bridge between knxd and MQTT
```

## package/mqtt-knx/Config.in
```kconfig
config BR2_PACKAGE_MQTT_KNX
        bool "mqtt-knx"
        help
          NodeJS KNX to MQTT bridge
          https://github.com/krambox/mqtt-knx
```

## package/rpi3-wifi-firmware/Config.in
```kconfig
config BR2_PACKAGE_RPI3_WIFI_FIRMWARE
	bool "rpi3-wifi-firmware"
	help
		Wifi firmware for Raspberry Pi 3
```
